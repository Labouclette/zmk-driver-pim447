## dts/bindings/sensor/pimoroni,trackball_pim447.yaml
```yaml
description: Pimoroni Trackball (PIM447) I2C sensor

compatible: "pimoroni,trackball_pim447"

include: i2c-device.yaml

properties:
  sensitivity:
    type: int
    default: 64

  move-factor:
    type: int
    default: 1

  scroll-factor:
    type: int
    default: 1

  led-red:
    type: int
    default: 0

  led-green:
    type: int
    default: 0

  led-blue:
    type: int
    default: 0

  invert-x:
    type: boolean

  invert-y:
    type: boolean
```
